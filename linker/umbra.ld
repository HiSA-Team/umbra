/*********************************************************************************************************
*
*   Author: Stefano Mercogliano <stefano.mercogliano@unina.it>
*   Description:
*       TBD
*
**********************************************************************************************************/

SECTIONS
{
    /************************************
    *      ___                          *
    *     / __| ___ __ _  _ _ _ ___     *
    *     \__ \/ -_) _| || | '_/ -_)    *
    *     |___/\___\__|\_,_|_| \___|    *
    *                                   *
    ************************************/

    /***************
    * Kernel Area  *
    ****************/

    .umbra_api_implementation :
    {
        KEEP(*(.text.umbra_tee_create_imp))
        KEEP(*(.text.umbra_debug_print_imp))
        KEEP(*(.text.umbra_enclave_enter_imp))
        KEEP(*(.text.umbra_enclave_exit_imp))
        KEEP(*(.text.umbra_enclave_status_imp))
        KEEP(*(.umbra_api_implementation))
    } > _SECURE_KERNEL_TEXT_MEMORY_

    /****************************************************
    *      _  _             ___                         *
    *     | \| |___ _ _ ___/ __| ___ __ _  _ _ _ ___    *
    *     | .` / _ \ ' \___\__ \/ -_) _| || | '_/ -_)   *
    *     |_|\_\___/_||_|  |___/\___\__|\_,_|_| \___|   *
    *      / __|__ _| | |__ _| |__| |___                *
    *     | (__/ _` | | / _` | '_ \ / -_)               *
    *      \___\__,_|_|_\__,_|_.__/_\___|               *
    *                                                   *
    ****************************************************/

    .umbra_nsc_api : 
    {
        . = ALIGN(32);
        KEEP(*(.umbra_nsc_api));  
    } > _NSC_TEXT_MEMORY_
}